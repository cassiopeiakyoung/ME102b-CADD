#include <Arduino.h>
#define BTN 27  // declare the button ED pin number
#define SPK 25  // declare the speaker pin number
#define POT 34  // declare the potentiometer pin number
#define LED_PIN 13 // declare the builtin LED pin number

//Setup variables ------------------------------------
const int freq = 5000;
const int pwmChannel = 0;
const int resolution = 8;
volatile bool buttonIsPressed = false;
int state = 1;

// hw_timer_t * timer = NULL;
// portMUX_TYPE timerMux = portMUX_INITIALIZER_UNLOCKED;

//Initialization ------------------------------------
void IRAM_ATTR isr() {  // the function to be called when interrupt is triggered
//  portENTER_CRITICAL_ISR(&timerMux);
  buttonIsPressed = true;
//  portEXIT_CRITICAL_ISR(&timerMux);
}

// void TimerInterruptInit() {  //The timer simply counts the number of Tic generated by the quartz. With a quartz clocked at 80MHz, we will have 80,000,000 Tics.
//   timer = timerBegin(0, 80, true); // divides the frequency by the prescaler: 80,000,000 / 80 = 1,000,000 tics / sec
//   timerAttachInterrupt(timer, &isr, true);    // sets which function do you want to call when the interrupt is triggered
//   timerAlarmWrite(timer, 5000000, true);         // sets how many tics will you count to trigger the interrupt
//   timerAlarmEnable(timer); // Enables timer
// }

void setup() {
  // put your setup code here, to run once:
  pinMode(BTN, INPUT);  // configures the specified pin to behave either as an input or an output
  pinMode(LED_PIN, OUTPUT); 
  attachInterrupt(BTN, isr, RISING);
  ledcSetup(pwmChannel, freq, resolution);
  ledcAttachPin(SPK, pwmChannel);
  Serial.begin(115200);
//  TimerInterruptInit();
}

void loop() {
  // put your main code here, to run repeatedly:
  delay(100);
  int dist = analogRead(POT);
  switch (state) {
    case 1:
      Serial.println("Disarmed");
      // timerStop(timer); // Stop timer

      if (CheckForButtonPress() == true) {
        led_on();
        state = 2;
      }
      break;
      
    case 2:
      Serial.println("Armed");
      // timerStop(timer); // Stop timer

      if (CheckForButtonPress() == true) {
        led_off();
        state = 1;
      }

      if (dist < 2048) {
        sound_on();
        state = 3;
      }

      break;
      
      case 3:
        Serial.println("Alarmed");
        // timerStart(timer); // Enables timer

        if (CheckForButtonPress() == true) {
          led_off();
          sound_off();
          state = 1;
        }

        if (dist >= 2048) {
          sound_off();
          state = 2;
        }

      break;
  }
}

bool CheckForButtonPress() {
  if (buttonIsPressed == true){
    buttonIsPressed = false;
    return true;
  }
  else {
    return false;
  }
}

void sound_on() {
  ledcAttachPin(SPK, pwmChannel);
  ledcWriteTone(pwmChannel, 440);
}

void sound_off() {
  ledcDetachPin(SPK);
  ledcWriteTone(pwmChannel, 0);
}

void led_on() {
  digitalWrite(LED_PIN, HIGH);
}

void led_off() {
  digitalWrite(LED_PIN, LOW);
}
